#include <Wire.h>
#include <Adafruit_GFX.h>
#include <Adafruit_SSD1306.h>
#include <Preferences.h>
#include <BleGamepad.h>
#include <nvs_flash.h> 
#include "USB.h"
#include "USBHIDMouse.h"
#include "USBHIDGamepad.h"
#include "USBHIDKeyboard.h" 

// Hardware Drivers
USBHIDMouse Mouse;
USBHIDGamepad Gamepad;
USBHIDKeyboard Keyboard;    
BleGamepad bleGamepad("Custom OS Controller", "ESP32", 100);
Preferences preferences;

// OLED Config
#define SCREEN_WIDTH 128
#define SCREEN_HEIGHT 64
Adafruit_SSD1306 display(SCREEN_WIDTH, SCREEN_HEIGHT, &Wire, -1);

// ==========================================
// BITMAP IMAGES
// ==========================================
const uint8_t bootLogoBitmap[] PROGMEM = {
	0x00, 0x00, 0x00, 0x00, 0x00, 0x00, 0x00, 0x00, 0x00, 0x00, 0x00, 0x00, 0x00, 0x00, 0x00, 0x00, 
	0x00, 0x00, 0x00, 0x00, 0x00, 0x00, 0x00, 0x00, 0x00, 0x00, 0x00, 0x00, 0x00, 0x00, 0x00, 0x00, 
	0x00, 0x00, 0x00, 0x00, 0x00, 0x00, 0x00, 0x00, 0x00, 0x00, 0x00, 0x00, 0x00, 0x00, 0x00, 0x00, 
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	0x00, 0x00, 0x00, 0x00, 0x00, 0x00, 0x00, 0x00, 0x00, 0x00, 0x00, 0x00, 0x00, 0x00, 0x00, 0x00
};

const uint8_t epd_bitmap_missilis1[] PROGMEM = {
	0x00, 0x00, 0x00, 0x00, 0x00, 0x00, 0x00, 0x00, 0x00, 0x00, 0x00, 0x00, 0x00, 0x00, 0x00, 0x00, 
	0x00, 0x00, 0x00, 0x00, 0x00, 0x00, 0x00, 0x00, 0x00, 0x00, 0x00, 0x00, 0x00, 0x00, 0x00, 0x00, 
	0x00, 0x00, 0x00, 0x00, 0x00, 0x00, 0x00, 0x00, 0x00, 0x00, 0x00, 0x00, 0x00, 0x00, 0x00, 0x00, 
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	0x00, 0x00, 0x00, 0x00, 0x00, 0x00, 0x00, 0x00, 0x00, 0x00, 0x00, 0x00, 0x00, 0x00, 0x00, 0x00
};

const uint8_t epd_bitmap_Faction_Marcel_Group_Icon123[] PROGMEM = {
	0x00, 0x00, 0x00, 0x00, 0x00, 0x00, 0x00, 0x00, 0x00, 0x00, 0x00, 0x00, 0x00, 0x00, 0x00, 0x00, 
	0x00, 0x00, 0x00, 0x00, 0x00, 0x00, 0x00, 0x00, 0x00, 0x00, 0x00, 0x00, 0x00, 0x00, 0x00, 0x00, 
	0x00, 0x00, 0x00, 0x00, 0x00, 0x00, 0x00, 0x00, 0x00, 0x00, 0x00, 0x00, 0x00, 0x00, 0x00, 0x00, 
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	0x00, 0x00, 0x00, 0x00, 0x00, 0x00, 0x00, 0x00, 0x00, 0x00, 0x00, 0x00, 0x00, 0x00, 0x00, 0x00
};

const uint8_t epd_bitmap_download128[] PROGMEM = {
	0x00, 0x00, 0x00, 0x00, 0x00, 0x00, 0x00, 0x00, 0x00, 0x00, 0x00, 0x00, 0x00, 0x00, 0x00, 0x00, 
	0x00, 0x00, 0x00, 0x00, 0x00, 0x00, 0x00, 0x00, 0x00, 0x00, 0x00, 0x00, 0x00, 0x00, 0x00, 0x00, 
	0x00, 0x00, 0x00, 0x00, 0x00, 0x00, 0x00, 0x00, 0x00, 0x00, 0x00, 0x00, 0x00, 0x00, 0x00, 0x00, 
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	0x00, 0x00, 0x00, 0x00, 0x00, 0x00, 0x00, 0x00, 0x00, 0x00, 0x00, 0x00, 0x00, 0x00, 0x00, 0x00
};

const uint8_t epd_bitmap_images123456[] PROGMEM = {
	0x00, 0x00, 0x00, 0x00, 0x00, 0x00, 0x00, 0x00, 0x00, 0x00, 0x00, 0x00, 0x00, 0x00, 0x00, 0x00, 
	0x00, 0x00, 0x00, 0x00, 0x00, 0x00, 0x00, 0x00, 0x00, 0x00, 0x00, 0x00, 0x00, 0x00, 0x00, 0x00, 
	0x00, 0x00, 0x00, 0x00, 0x00, 0x00, 0x00, 0x00, 0x00, 0x00, 0x00, 0x00, 0x09, 0xc0, 0x00, 0x00, 
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	0x00, 0x00, 0x00, 0x00, 0x00, 0x00, 0x00, 0x00, 0x00, 0x00, 0x00, 0x00, 0x00, 0x00, 0x00, 0x00
};

// Pins
const int JOY1_X = 1; const int JOY1_Y = 2;
const int JOY2_X = 3; const int JOY2_Y = 4;
const int buttonPins[13] = {6, 5, 7, 10, 11, 12, 13, 14, 15, 16, 17, 18, 38};
bool buttonStates[13]; bool lastButtonStates[13];

// DYNAMIC NAVIGATION PINS
int BTN_IDX_OK = 10;    
int BTN_IDX_BACK = 11;  
const int BTN_IDX_MENU_1 = 4; 
const int BTN_IDX_MENU_2 = 9; 

// ==========================================
// VIRTUAL DICTIONARIES
// ==========================================
#define BTN_A (1<<0)
#define BTN_B (1<<1)
#define BTN_X (1<<2)
#define BTN_Y (1<<3)
#define BTN_L1 (1<<4)
#define BTN_R1 (1<<5)
#define BTN_L2 (1<<6) 
#define BTN_R2 (1<<7) 
#define BTN_L3 (1<<8)     
#define BTN_R3 (1<<9)     
#define BTN_START (1<<10) 
#define BTN_SELECT (1<<11) 
#define BTN_HOME (1<<12)
#define DPAD_UP (1<<16)
#define DPAD_DOWN (1<<17)
#define DPAD_LEFT (1<<18)
#define DPAD_RIGHT (1<<19)

#define CMD_M_LEFT 253
#define CMD_M_RIGHT 254
#define CMD_M_MID 255

const uint32_t gpValues[] = { 0, BTN_A, BTN_B, BTN_X, BTN_Y, BTN_L1, BTN_R1, BTN_L2, BTN_R2, BTN_L3, BTN_R3, BTN_START, BTN_SELECT, BTN_HOME, DPAD_UP, DPAD_DOWN, DPAD_LEFT, DPAD_RIGHT };
const char* gpNames[] = { "NONE", "A", "B", "X", "Y", "L1", "R1", "L2", "R2", "L3", "R3", "START", "SELECT", "HOME", "D-UP", "D-DOWN", "D-LEFT", "D-RIGHT" };
const int NUM_GP_OPTS = 18;

const uint8_t kbValues[] = {
  0, 'a','b','c','d','e','f','g','h','i','j','k','l','m','n','o','p','q','r','s','t','u','v','w','x','y','z',
  '1','2','3','4','5','6','7','8','9','0', ' ', KEY_RETURN, KEY_ESC, KEY_TAB, KEY_BACKSPACE,
  KEY_LEFT_SHIFT, KEY_LEFT_CTRL, KEY_LEFT_ALT, KEY_UP_ARROW, KEY_DOWN_ARROW, KEY_LEFT_ARROW, KEY_RIGHT_ARROW,
  CMD_M_LEFT, CMD_M_RIGHT, CMD_M_MID
};
const char* kbNames[] = {
  "NONE", "A","B","C","D","E","F","G","H","I","J","K","L","M","N","O","P","Q","R","S","T","U","V","W","X","Y","Z",
  "1","2","3","4","5","6","7","8","9","0", "SPACE", "ENTER", "ESC", "TAB", "BKSP",
  "SHIFT", "CTRL", "ALT", "UP", "DOWN", "LEFT", "RIGHT",
  "M-LEFT", "M-RIGHT", "M-MID"
};
const int NUM_KB_OPTS = 52; 

// ==========================================
// DYNAMIC CONFIGURATION VARIABLES
// ==========================================
bool conf_use_ble = false; 
uint8_t conf_boot_logo = 0; 
bool conf_boot_invert = false; 

uint8_t gp_map_idx[13]; uint8_t kb_map_idx[13];
int j1x_center, j1y_center, j2x_center, j2y_center;
int conf_deadzone, conf_mouse_sens; float conf_mouse_accel;

bool gp_j1_swap, gp_j1_invX, gp_j1_invY;
bool gp_j2_swap, gp_j2_invX, gp_j2_invY;
uint8_t gp_j1_mode, gp_j2_mode; 

bool mk_j1_swap, mk_j1_invX, mk_j1_invY;
bool mk_j2_swap, mk_j2_invX, mk_j2_invY;
uint8_t mk_j2_mode; 

String profNames[10];
const int MAX_PROFS = 10;

enum Mode { MODE_MENU, MODE_GAMEPAD, MODE_MOUSE, MODE_TESTER }; 
Mode currentMode = MODE_MENU;

enum MenuCat { 
  CAT_MAIN, CAT_GP_MENU, CAT_GP_MAP, CAT_GP_J1, CAT_GP_J2, 
  CAT_MK_MENU, CAT_KB_MAP, CAT_MK_J1, CAT_MK_J2, CAT_MOUSE_CFG,
  CAT_PROFILES, CAT_PROF_SAVE_OPT, 
  CAT_LIST_LOAD, CAT_LIST_OVERWRITE, CAT_LIST_RENAME, CAT_LIST_DELETE,
  CAT_TEXT_ENTRY, CAT_SYS_CFG
};
MenuCat currentCat = CAT_MAIN;
MenuCat returnCat = CAT_MAIN; 

int scrollIndex = 0; bool isEditing = false; int editValue = 0;
unsigned long lastScrollTime = 0; const int SCROLL_DELAY = 200;
unsigned long lastXScrollTime = 0; 
unsigned long lastOledUpdate = 0;

// Hardware Tracker for Smart USB Polling
int8_t last_gp_j1x = 0, last_gp_j1y = 0, last_gp_j2x = 0, last_gp_j2y = 0;
int8_t last_gp_trigL = 0, last_gp_trigR = 0;
uint8_t last_gp_hat = 0; uint32_t last_gp_btn = 0;

char textBuffer[11] = "          "; int textCursor = 0;
const char charset[] = "ABCDEFGHIJKLMNOPQRSTUVWXYZ0123456789 -_";
const int charsetLen = 39; 
int targetProfileSlot = -1;

// ==========================================
// FORWARD DECLARATIONS 
// ==========================================
void switchMode(Mode newMode);
void handleMenu();
void handleGamepad();
void handleMouse();
void handleTester();
void updateOLED();
void handleTextEditor(int8_t j1x, int8_t j1y);
void calibrateSticks();
int8_t processAxis(int rawValue, int centerValue, bool invert);
void getJoystickStates(int8_t &outJ1X, int8_t &outJ1Y, int8_t &outJ2X, int8_t &outJ2Y, bool isGamepad);
void loadConfigFromSlot(String slot); void saveConfigToSlot(String slot); void saveProfileName(int idx, String name);
void applySaneDefaults(); int getFirstEmptyProfileSlot();

// ==========================================
// SETUP & LOOP
// ==========================================
void setup() {
  Serial.begin(115200);

  for (int i = 0; i < 13; i++) {
    pinMode(buttonPins[i], INPUT_PULLUP);
    buttonStates[i] = false; lastButtonStates[i] = false;
  }

  // --- NVS CORRUPTION REPAIR ---
  esp_err_t err = nvs_flash_init();
  if (err == ESP_ERR_NVS_NO_FREE_PAGES || err == ESP_ERR_NVS_NEW_VERSION_FOUND) {
    nvs_flash_erase();
    nvs_flash_init();
  }

  // Read System Variables
  preferences.begin("sys", true);
  conf_use_ble = preferences.getBool("ble", false);
  conf_boot_logo = preferences.getUChar("bootlogo", 0);
  conf_boot_invert = preferences.getBool("bootinv", false);
  BTN_IDX_OK = preferences.getInt("btnok", 10);
  BTN_IDX_BACK = preferences.getInt("btnback", 11);
  uint8_t current_cycle_idx = preferences.getUChar("bootcyc", 0);
  
  for(int i=0; i<MAX_PROFS; i++) {
    String key = "n" + String(i);
    profNames[i] = preferences.getString(key.c_str(), "");
  }
  preferences.end();

  loadConfigFromSlot("default");

  Wire.begin(8, 9);
  if(!display.begin(SSD1306_SWITCHCAPVCC, 0x3C)) { for(;;); }
  
  // --- THE BOOT SEQUENCE ---
  uint8_t display_mode = conf_boot_logo;
  if (display_mode == 6) { 
    display_mode = current_cycle_idx;
    current_cycle_idx++;
    if (current_cycle_idx > 4) current_cycle_idx = 0;
    preferences.begin("sys", false);
    preferences.putUChar("bootcyc", current_cycle_idx);
    preferences.end();
  }

  display.clearDisplay(); 
  uint16_t fg = conf_boot_invert ? SSD1306_BLACK : SSD1306_WHITE;
  uint16_t bg = conf_boot_invert ? SSD1306_WHITE : SSD1306_BLACK;
  if (conf_boot_invert) display.fillScreen(SSD1306_WHITE);

  if (display_mode == 0) { display.drawBitmap(0, 0, bootLogoBitmap, 128, 64, fg); } 
  else if (display_mode == 1) { display.drawBitmap(0, 0, epd_bitmap_missilis1, 128, 64, fg); }
  else if (display_mode == 2) { display.drawBitmap(0, 0, epd_bitmap_Faction_Marcel_Group_Icon123, 128, 64, fg); }
  else if (display_mode == 3) { display.drawBitmap(0, 0, epd_bitmap_download128, 128, 64, fg); }
  else if (display_mode == 4) { display.drawBitmap(0, 0, epd_bitmap_images123456, 128, 64, fg); }
  else if (display_mode == 5) {
    display.setTextColor(fg, bg); display.setTextSize(2);
    display.setCursor(10, 20); display.println(F("OS BOOTING")); 
  }
  display.display(); 
  delay(1500); 

  if (conf_use_ble) {
    bleGamepad.begin();
  } else {
    Mouse.begin(); Gamepad.begin(); Keyboard.begin(); USB.begin();
    Gamepad.send(0, 0, 0, 0, 0, 0, 0, 0);
  }
}

void loop() {
  for (int i = 0; i < 13; i++) buttonStates[i] = (digitalRead(buttonPins[i]) == LOW);

  if (buttonStates[BTN_IDX_MENU_1] && buttonStates[BTN_IDX_MENU_2]) {
    switchMode(MODE_MENU);
  }

  switch (currentMode) {
    case MODE_MENU:    handleMenu(); break;
    case MODE_GAMEPAD: handleGamepad(); break;
    case MODE_MOUSE:   handleMouse(); break;
    case MODE_TESTER:  handleTester(); break; 
  }

  for (int i = 0; i < 13; i++) lastButtonStates[i] = buttonStates[i];
  delay(10); 
}

// ==========================================
// SMART MODE SWITCHING
// ==========================================
void switchMode(Mode newMode) {
  if (currentMode == newMode) return;

  // RELEASE ALL STATES BEFORE SWITCHING TO PREVENT ZZZ FILTER CRASH
  if (!conf_use_ble) {
    Keyboard.releaseAll();
    Mouse.release(MOUSE_LEFT); Mouse.release(MOUSE_RIGHT); Mouse.release(MOUSE_MIDDLE);
    Gamepad.send(0, 0, 0, 0, 0, 0, 0, 0); // Send ONE single zero report
  } else {
    if (bleGamepad.isConnected()) {
      bleGamepad.setLeftThumb(0, 0);
      bleGamepad.setRightThumb(0, 0);
      bleGamepad.setLeftTrigger(0);
      bleGamepad.setRightTrigger(0);
      bleGamepad.setHat1(0);
      for (int i = 1; i <= 16; i++) bleGamepad.release(i);
    }
  }

  // Force Gamepad Engine to send immediately on next boot
  last_gp_j1x=0; last_gp_j1y=0; last_gp_j2x=0; last_gp_j2y=0;
  last_gp_trigL=0; last_gp_trigR=0; last_gp_hat=0; last_gp_btn=0;

  currentMode = newMode;
  isEditing = false;
  scrollIndex = 0;
  lastOledUpdate = 0; // Force immediate screen refresh

  if (newMode == MODE_MENU) {
    currentCat = CAT_MAIN;
  }
}

// ==========================================
// PROFILE STORAGE SYSTEM
// ==========================================
void applySaneDefaults() {
  gp_map_idx[0] = 1; gp_map_idx[1] = 2; gp_map_idx[2] = 3; gp_map_idx[3] = 4;
  gp_map_idx[4] = 5; gp_map_idx[5] = 6; gp_map_idx[6] = 14; gp_map_idx[7] = 15;
  gp_map_idx[8] = 16; gp_map_idx[9] = 11; gp_map_idx[10] = 9; gp_map_idx[11] = 10; gp_map_idx[12] = 17;
  
  kb_map_idx[0] = 49; kb_map_idx[1] = 50; kb_map_idx[2] = 37; kb_map_idx[3] = 18;
  kb_map_idx[4] = 0; kb_map_idx[5] = 6; kb_map_idx[6] = 17; kb_map_idx[7] = 5;
  kb_map_idx[8] = 38; kb_map_idx[9] = 0; kb_map_idx[10] = 24; kb_map_idx[11] = 25; kb_map_idx[12] = 39;

  j1x_center=2048; j1y_center=2048; j2x_center=2048; j2y_center=2048;
  conf_deadzone=150; conf_mouse_sens=5; conf_mouse_accel=1.8;
  gp_j1_swap=false; gp_j1_invX=false; gp_j1_invY=false; gp_j2_swap=false; gp_j2_invX=false; gp_j2_invY=false;
  gp_j1_mode=0; gp_j2_mode=1;
  mk_j1_swap=false; mk_j1_invX=false; mk_j1_invY=false; mk_j2_swap=false; mk_j2_invX=false; mk_j2_invY=false; mk_j2_mode=2; // Default WASD
}

void loadConfigFromSlot(String slot) {
  preferences.begin(slot.c_str(), true);
  size_t testLen = preferences.getBytes("gpmap", gp_map_idx, 13);
  
  if (testLen == 0) {
    applySaneDefaults();
  } else {
    preferences.getBytes("kbmap", kb_map_idx, 13);
    j1x_center = preferences.getInt("j1xc", 2048); j1y_center = preferences.getInt("j1yc", 2048);
    j2x_center = preferences.getInt("j2xc", 2048); j2y_center = preferences.getInt("j2yc", 2048);
    conf_deadzone = preferences.getInt("dz", 150);
    conf_mouse_sens = preferences.getInt("msens", 5); conf_mouse_accel = preferences.getFloat("maccel", 1.8);
    
    gp_j1_swap = preferences.getBool("g1s", false); gp_j1_invX = preferences.getBool("g1ix", false); gp_j1_invY = preferences.getBool("g1iy", false);
    gp_j2_swap = preferences.getBool("g2s", false); gp_j2_invX = preferences.getBool("g2ix", false); gp_j2_invY = preferences.getBool("g2iy", false);
    gp_j1_mode = preferences.getUChar("g1m", 0); gp_j2_mode = preferences.getUChar("g2m", 1);
    
    mk_j1_swap = preferences.getBool("m1s", false); mk_j1_invX = preferences.getBool("m1ix", false); mk_j1_invY = preferences.getBool("m1iy", false);
    mk_j2_swap = preferences.getBool("m2s", false); mk_j2_invX = preferences.getBool("m2ix", false); mk_j2_invY = preferences.getBool("m2iy", false);
    mk_j2_mode = preferences.getUChar("m2m", 2); 
  }
  preferences.end();
}

void saveConfigToSlot(String slot) {
  preferences.begin(slot.c_str(), false);
  preferences.putBytes("gpmap", gp_map_idx, 13); preferences.putBytes("kbmap", kb_map_idx, 13);
  preferences.putInt("j1xc", j1x_center); preferences.putInt("j1yc", j1y_center);
  preferences.putInt("j2xc", j2x_center); preferences.putInt("j2yc", j2y_center);
  preferences.putInt("dz", conf_deadzone);
  preferences.putInt("msens", conf_mouse_sens); preferences.putFloat("maccel", conf_mouse_accel);
  
  preferences.putBool("g1s", gp_j1_swap); preferences.putBool("g1ix", gp_j1_invX); preferences.putBool("g1iy", gp_j1_invY);
  preferences.putBool("g2s", gp_j2_swap); preferences.putBool("g2ix", gp_j2_invX); preferences.putBool("g2iy", gp_j2_invY);
  preferences.putUChar("g1m", gp_j1_mode); preferences.putUChar("g2m", gp_j2_mode);
  
  preferences.putBool("m1s", mk_j1_swap); preferences.putBool("m1ix", mk_j1_invX); preferences.putBool("m1iy", mk_j1_invY);
  preferences.putBool("m2s", mk_j2_swap); preferences.putBool("m2ix", mk_j2_invX); preferences.putBool("m2iy", mk_j2_invY);
  preferences.putUChar("m2m", mk_j2_mode);
  preferences.end();
}

void saveProfileName(int idx, String name) {
  profNames[idx] = name;
  preferences.begin("sys", false); String key = "n" + String(idx);
  preferences.putString(key.c_str(), name); preferences.end();
}

void resetToDefaults() {
  applySaneDefaults();
  saveConfigToSlot("default");
}

int getFirstEmptyProfileSlot() {
  for(int i=0; i<MAX_PROFS; i++) if(profNames[i] == "") return i;
  return -1;
}

// ==========================================
// CORE HARDWARE MATH
// ==========================================
void calibrateSticks() {
  display.clearDisplay(); display.setTextSize(1); display.setCursor(0, 20);
  display.println(F("Leave sticks neutral!")); display.println(F("Calibrating in 1s...")); display.display(); delay(1000);
  long s_j1x = 0, s_j1y = 0, s_j2x = 0, s_j2y = 0; int samples = 50;
  for(int i=0; i<samples; i++) {
    s_j1x += analogRead(JOY1_X); s_j1y += analogRead(JOY1_Y); s_j2x += analogRead(JOY2_X); s_j2y += analogRead(JOY2_Y); delay(10);
  }
  j1x_center = s_j1x / samples; j1y_center = s_j1y / samples; j2x_center = s_j2x / samples; j2y_center = s_j2y / samples;
  saveConfigToSlot("default");
  display.clearDisplay(); display.setCursor(0, 20); display.println(F("Done & Saved!")); display.display(); delay(1000);
}

int8_t processAxis(int rawValue, int centerValue, bool invert) {
  int diff = rawValue - centerValue; if (abs(diff) < conf_deadzone) return 0;
  float scaled = (diff > 0) ? (float)(diff - conf_deadzone) / (4095 - centerValue - conf_deadzone) * 127.0 : (float)(diff + conf_deadzone) / (centerValue - conf_deadzone) * 127.0;
  int finalVal = constrain((int)scaled, -127, 127); return (int8_t)(invert ? -finalVal : finalVal);
}

void getJoystickStates(int8_t &outJ1X, int8_t &outJ1Y, int8_t &outJ2X, int8_t &outJ2Y, bool isGamepad) {
  bool s1 = isGamepad ? gp_j1_swap : mk_j1_swap;
  bool ix1 = isGamepad ? gp_j1_invX : mk_j1_invX;
  bool iy1 = isGamepad ? gp_j1_invY : mk_j1_invY;
  bool s2 = isGamepad ? gp_j2_swap : mk_j2_swap;
  bool ix2 = isGamepad ? gp_j2_invX : mk_j2_invX;
  bool iy2 = isGamepad ? gp_j2_invY : mk_j2_invY;

  int8_t j1x = processAxis(analogRead(JOY1_X), j1x_center, ix1); int8_t j1y = processAxis(analogRead(JOY1_Y), j1y_center, iy1);
  int8_t j2x = processAxis(analogRead(JOY2_X), j2x_center, ix2); int8_t j2y = processAxis(analogRead(JOY2_Y), j2y_center, iy2);
  outJ1X = s1 ? j1y : j1x; outJ1Y = s1 ? j1x : j1y; outJ2X = s2 ? j2y : j2x; outJ2Y = s2 ? j2x : j2y;
}

// ==========================================
// TEXT EDITOR ENGINE 
// ==========================================
void openTextEditor(MenuCat retCat, const char* preloadName) {
  returnCat = retCat; currentCat = CAT_TEXT_ENTRY; textCursor = 0;
  for(int i=0; i<10; i++) textBuffer[i] = ' '; textBuffer[10] = '\0';
  int len = String(preloadName).length();
  for(int i=0; i<len && i<10; i++) textBuffer[i] = preloadName[i];
  if(textBuffer[0] == ' ') textBuffer[0] = 'A'; 
}

void handleTextEditor(int8_t j1x, int8_t j1y) {
  if (millis() - lastScrollTime > SCROLL_DELAY) {
    if (j1y > 64 || j1y < -64) {
      char curr = textBuffer[textCursor]; 
      int cIdx = 0;
      for(int i=0; i<charsetLen; i++) { if(charset[i] == curr) { cIdx = i; break; } }
      if (j1y < -64) cIdx++; else cIdx--;
      
      if (cIdx < 0) cIdx = charsetLen - 1; 
      if (cIdx >= charsetLen) cIdx = 0;
      textBuffer[textCursor] = charset[cIdx]; 
      lastScrollTime = millis();
    }
  }
  
  if (millis() - lastXScrollTime > SCROLL_DELAY) {
    if (j1x > 64 || j1x < -64) {
      if (j1x > 64) { textCursor++; if(textCursor > 9) textCursor = 0; } 
      if (j1x < -64) { textCursor--; if(textCursor < 0) textCursor = 9; } 
      lastXScrollTime = millis();
    }
  }

  if (btnPressed(BTN_IDX_OK)) {
    String finalName = String(textBuffer); finalName.trim();
    if(finalName == "") finalName = "PROFILE";
    saveProfileName(targetProfileSlot, finalName);
    saveConfigToSlot("p" + String(targetProfileSlot));
    currentCat = returnCat; scrollIndex = 0; targetProfileSlot = -1;
  }
  if (btnPressed(BTN_IDX_BACK)) { currentCat = returnCat; scrollIndex = 0; targetProfileSlot = -1; }
}

// ==========================================
// OS MENU NAVIGATION SYSTEM
// ==========================================
bool btnPressed(int idx) { return (buttonStates[idx] && !lastButtonStates[idx]); }

void handleMenu() {
  int8_t j1x, j1y, j2x, j2y;
  getJoystickStates(j1x, j1y, j2x, j2y, true); 

  if (currentCat == CAT_TEXT_ENTRY) { 
    handleTextEditor(j1x, j1y); 
    updateOLED(); 
    return; 
  }

  int listSize = 0;
  if (currentCat == CAT_MAIN) listSize = 9; 
  else if (currentCat == CAT_GP_MENU) listSize = 3;
  else if (currentCat == CAT_MK_MENU) listSize = 4;
  else if (currentCat == CAT_PROFILES) listSize = 5;
  else if (currentCat == CAT_PROF_SAVE_OPT) listSize = 2;
  else if (currentCat == CAT_LIST_LOAD || currentCat == CAT_LIST_OVERWRITE || currentCat == CAT_LIST_RENAME || currentCat == CAT_LIST_DELETE) listSize = 10;
  else if (currentCat == CAT_GP_MAP || currentCat == CAT_KB_MAP) listSize = 13;
  else if (currentCat == CAT_GP_J1 || currentCat == CAT_GP_J2 || currentCat == CAT_MK_J2) listSize = 4; 
  else if (currentCat == CAT_MK_J1 || currentCat == CAT_MOUSE_CFG) listSize = 3;
  else if (currentCat == CAT_SYS_CFG) listSize = 5;

  if (millis() - lastScrollTime > SCROLL_DELAY) {
    if (!isEditing) {
      if (j1y > 64) { scrollIndex++; lastScrollTime = millis(); }
      if (j1y < -64) { scrollIndex--; lastScrollTime = millis(); }
      if (scrollIndex < 0) scrollIndex = listSize - 1;
      if (scrollIndex >= listSize) scrollIndex = 0;
    } else {
      if (j1x > 64) { editValue++; lastScrollTime = millis(); }
      if (j1x < -64) { editValue--; lastScrollTime = millis(); }
      
      if (currentCat == CAT_GP_MAP) { if(editValue < 0) editValue = NUM_GP_OPTS-1; if(editValue >= NUM_GP_OPTS) editValue = 0; }
      else if (currentCat == CAT_KB_MAP) { if(editValue < 0) editValue = NUM_KB_OPTS-1; if(editValue >= NUM_KB_OPTS) editValue = 0; }
      else if (currentCat == CAT_GP_J1 && scrollIndex == 3) { if(editValue < 0) editValue = 2; if(editValue > 2) editValue = 0; }
      else if (currentCat == CAT_GP_J2 && scrollIndex == 3) { if(editValue < 0) editValue = 2; if(editValue > 2) editValue = 0; }
      else if (currentCat == CAT_MK_J2 && scrollIndex == 3) { if(editValue < 0) editValue = 2; if(editValue > 2) editValue = 0; } 
      else if (currentCat == CAT_MOUSE_CFG) {
        if(scrollIndex==0) { if(editValue < 1) editValue=20; if(editValue > 20) editValue=1; }
        if(scrollIndex==1) { if(editValue < 10) editValue=30; if(editValue > 30) editValue=10; } 
        if(scrollIndex==2) { if(editValue < 50) editValue=500; if(editValue > 500) editValue=50; }
      }
      else if (currentCat == CAT_SYS_CFG) { 
        if(scrollIndex == 0) { if(editValue < 0) editValue = 6; if(editValue > 6) editValue = 0; } 
        if(scrollIndex == 1) { if(editValue < 0) editValue = 1; if(editValue > 1) editValue = 0; } 
        if(scrollIndex == 2) { if(editValue < 0) editValue = 12; if(editValue > 12) editValue = 0; } 
        if(scrollIndex == 3) { if(editValue < 0) editValue = 12; if(editValue > 12) editValue = 0; } 
        if(scrollIndex == 4) { if(editValue < 0) editValue = 1; if(editValue > 1) editValue = 0; } 
      } 
      else { if(editValue < 0) editValue = 1; if(editValue > 1) editValue = 0; }
    }
  }

  if (btnPressed(BTN_IDX_OK)) {
    if (!isEditing) {
      if (currentCat == CAT_MAIN) {
        if (scrollIndex == 0) switchMode(MODE_GAMEPAD);
        else if (scrollIndex == 1) switchMode(MODE_MOUSE);
        else if (scrollIndex == 2) calibrateSticks();
        else if (scrollIndex == 3) {
          conf_use_ble = !conf_use_ble;
          preferences.begin("sys", false); preferences.putBool("ble", conf_use_ble); preferences.end();
          display.clearDisplay(); display.setTextColor(SSD1306_WHITE); display.setTextSize(2); 
          display.setCursor(10, 20); display.print(F("REBOOTING")); display.display();
          delay(1000); ESP.restart(); 
        }
        else if (scrollIndex == 4) { currentCat = CAT_PROFILES; scrollIndex = 0; }
        else if (scrollIndex == 5) { currentCat = CAT_GP_MENU; scrollIndex = 0; }
        else if (scrollIndex == 6) { currentCat = CAT_MK_MENU; scrollIndex = 0; }
        else if (scrollIndex == 7) { currentCat = CAT_SYS_CFG; scrollIndex = 0; }
        else if (scrollIndex == 8) { switchMode(MODE_TESTER); } 
      } 
      else if (currentCat == CAT_GP_MENU) {
        if(scrollIndex == 0) { currentCat = CAT_GP_MAP; scrollIndex = 0; }
        else if(scrollIndex == 1) { currentCat = CAT_GP_J1; scrollIndex = 0; }
        else if(scrollIndex == 2) { currentCat = CAT_GP_J2; scrollIndex = 0; }
      }
      else if (currentCat == CAT_MK_MENU) {
        if(scrollIndex == 0) { currentCat = CAT_KB_MAP; scrollIndex = 0; }
        else if(scrollIndex == 1) { currentCat = CAT_MK_J1; scrollIndex = 0; }
        else if(scrollIndex == 2) { currentCat = CAT_MK_J2; scrollIndex = 0; }
        else if(scrollIndex == 3) { currentCat = CAT_MOUSE_CFG; scrollIndex = 0; }
      }
      else if (currentCat == CAT_PROFILES) {
        if (scrollIndex == 0) { currentCat = CAT_LIST_LOAD; scrollIndex = 0; }
        else if (scrollIndex == 1) { 
          targetProfileSlot = getFirstEmptyProfileSlot();
          if(targetProfileSlot != -1) openTextEditor(CAT_PROFILES, ""); 
        }
        else if (scrollIndex == 2) { currentCat = CAT_PROF_SAVE_OPT; scrollIndex = 0; }
        else if (scrollIndex == 3) { currentCat = CAT_LIST_RENAME; scrollIndex = 0; }
        else if (scrollIndex == 4) { currentCat = CAT_LIST_DELETE; scrollIndex = 0; }
      }
      else if (currentCat == CAT_PROF_SAVE_OPT) {
        if (scrollIndex == 0) { currentCat = CAT_LIST_OVERWRITE; scrollIndex = 0; }
        else if (scrollIndex == 1) {
          targetProfileSlot = getFirstEmptyProfileSlot();
          if(targetProfileSlot != -1) openTextEditor(CAT_PROFILES, "");
        }
      }
      else if (currentCat == CAT_LIST_LOAD || currentCat == CAT_LIST_OVERWRITE || currentCat == CAT_LIST_RENAME || currentCat == CAT_LIST_DELETE) {
        if (profNames[scrollIndex] != "" || currentCat == CAT_LIST_OVERWRITE) {
          if (currentCat == CAT_LIST_LOAD) {
             loadConfigFromSlot("p" + String(scrollIndex)); saveConfigToSlot("default");
             currentCat = CAT_PROFILES; scrollIndex = 0;
          }
          else if (currentCat == CAT_LIST_OVERWRITE) {
             saveConfigToSlot("p" + String(scrollIndex));
             if(profNames[scrollIndex] == "") openTextEditor(CAT_PROFILES, "");
             else { currentCat = CAT_PROFILES; scrollIndex = 0; }
          }
          else if (currentCat == CAT_LIST_RENAME) {
             targetProfileSlot = scrollIndex; openTextEditor(CAT_PROFILES, profNames[scrollIndex].c_str());
          }
          else if (currentCat == CAT_LIST_DELETE) {
             saveProfileName(scrollIndex, ""); currentCat = CAT_PROFILES; scrollIndex = 0;
          }
        }
      }
      else {
        isEditing = true;
        if (currentCat == CAT_GP_MAP) editValue = gp_map_idx[scrollIndex];
        else if (currentCat == CAT_KB_MAP) editValue = kb_map_idx[scrollIndex];
        else if (currentCat == CAT_GP_J1) { if(scrollIndex==0) editValue=gp_j1_swap; if(scrollIndex==1) editValue=gp_j1_invX; if(scrollIndex==2) editValue=gp_j1_invY; if(scrollIndex==3) editValue=gp_j1_mode; }
        else if (currentCat == CAT_GP_J2) { if(scrollIndex==0) editValue=gp_j2_swap; if(scrollIndex==1) editValue=gp_j2_invX; if(scrollIndex==2) editValue=gp_j2_invY; if(scrollIndex==3) editValue=gp_j2_mode; }
        else if (currentCat == CAT_MK_J1) { if(scrollIndex==0) editValue=mk_j1_swap; if(scrollIndex==1) editValue=mk_j1_invX; if(scrollIndex==2) editValue=mk_j1_invY; }
        else if (currentCat == CAT_MK_J2) { if(scrollIndex==0) editValue=mk_j2_swap; if(scrollIndex==1) editValue=mk_j2_invX; if(scrollIndex==2) editValue=mk_j2_invY; if (scrollIndex==3) editValue=mk_j2_mode; }
        else if (currentCat == CAT_MOUSE_CFG) { if(scrollIndex==0) editValue=conf_mouse_sens; if(scrollIndex==1) editValue=(int)(conf_mouse_accel*10); if(scrollIndex==2) editValue=conf_deadzone; }
        else if (currentCat == CAT_SYS_CFG) { 
          if(scrollIndex==0) editValue=conf_boot_logo; 
          if(scrollIndex==1) editValue=conf_boot_invert; 
          if(scrollIndex==2) editValue=BTN_IDX_OK;
          if(scrollIndex==3) editValue=BTN_IDX_BACK;
          if(scrollIndex==4) editValue=0; 
        }
      }
    } 
    else {
      isEditing = false;
      if (currentCat == CAT_GP_MAP) gp_map_idx[scrollIndex] = editValue;
      else if (currentCat == CAT_KB_MAP) kb_map_idx[scrollIndex] = editValue;
      else if (currentCat == CAT_GP_J1) { if(scrollIndex==0) gp_j1_swap=editValue; if(scrollIndex==1) gp_j1_invX=editValue; if(scrollIndex==2) gp_j1_invY=editValue; if(scrollIndex==3) gp_j1_mode=editValue; }
      else if (currentCat == CAT_GP_J2) { if(scrollIndex==0) gp_j2_swap=editValue; if(scrollIndex==1) gp_j2_invX=editValue; if(scrollIndex==2) gp_j2_invY=editValue; if(scrollIndex==3) gp_j2_mode=editValue; }
      else if (currentCat == CAT_MK_J1) { if(scrollIndex==0) mk_j1_swap=editValue; if(scrollIndex==1) mk_j1_invX=editValue; if(scrollIndex==2) mk_j1_invY=editValue; }
      else if (currentCat == CAT_MK_J2) { if(scrollIndex==0) mk_j2_swap=editValue; if(scrollIndex==1) mk_j2_invX=editValue; if(scrollIndex==2) mk_j2_invY=editValue; if(scrollIndex==3) mk_j2_mode=editValue; }
      else if (currentCat == CAT_MOUSE_CFG) { if(scrollIndex==0) conf_mouse_sens=editValue; if(scrollIndex==1) conf_mouse_accel=(float)editValue/10.0; if(scrollIndex==2) conf_deadzone=editValue; }
      else if (currentCat == CAT_SYS_CFG) { 
        if(scrollIndex==0) { conf_boot_logo=editValue; preferences.begin("sys", false); preferences.putUChar("bootlogo", conf_boot_logo); preferences.end(); }
        if(scrollIndex==1) { conf_boot_invert=editValue; preferences.begin("sys", false); preferences.putBool("bootinv", conf_boot_invert); preferences.end(); }
        if(scrollIndex==2) { BTN_IDX_OK=editValue; preferences.begin("sys", false); preferences.putInt("btnok", BTN_IDX_OK); preferences.end(); }
        if(scrollIndex==3) { BTN_IDX_BACK=editValue; preferences.begin("sys", false); preferences.putInt("btnback", BTN_IDX_BACK); preferences.end(); }
        if(scrollIndex==4 && editValue==1) { 
          applySaneDefaults(); saveConfigToSlot("default");
          for(int i=0; i<10; i++) saveProfileName(i, ""); 
          display.clearDisplay(); display.setCursor(0,20); display.print(F("WIPED!")); display.display(); delay(1000);
        }
      }
      saveConfigToSlot("default");
    }
  }

  if (btnPressed(BTN_IDX_BACK)) {
    if (isEditing) isEditing = false;
    else {
      if (currentCat == CAT_PROFILES || currentCat == CAT_GP_MENU || currentCat == CAT_MK_MENU || currentCat == CAT_SYS_CFG) { currentCat = CAT_MAIN; scrollIndex = 0; }
      else if (currentCat == CAT_GP_MAP || currentCat == CAT_GP_J1 || currentCat == CAT_GP_J2) { currentCat = CAT_GP_MENU; scrollIndex = 0; }
      else if (currentCat == CAT_KB_MAP || currentCat == CAT_MK_J1 || currentCat == CAT_MK_J2 || currentCat == CAT_MOUSE_CFG) { currentCat = CAT_MK_MENU; scrollIndex = 0; }
      else if (currentCat == CAT_PROF_SAVE_OPT || currentCat == CAT_LIST_LOAD || currentCat == CAT_LIST_OVERWRITE || currentCat == CAT_LIST_RENAME || currentCat == CAT_LIST_DELETE) { currentCat = CAT_PROFILES; scrollIndex = 0; }
    }
  }
  updateOLED(); 
}

// ==========================================
// OLED RENDERING
// ==========================================
void printMenuRow(int idx, const char* title, const char* valStr, bool isBool = false) {
  if (idx == scrollIndex) display.print(isEditing ? F(" >[") : F(" > ")); else display.print(F("   "));
  display.print(title);
  if (valStr != nullptr) { if (isBool && idx == scrollIndex && isEditing) display.print(editValue ? F("TRUE") : F("FALSE")); else display.print(valStr); }
  if (idx == scrollIndex && isEditing) display.println(F("]")); else display.println();
}

void updateOLED() {
  display.clearDisplay(); display.setTextColor(SSD1306_WHITE); display.setTextSize(1); display.setCursor(0,0);
  
  if (currentCat == CAT_TEXT_ENTRY) {
    display.println(F("ENTER PROFILE NAME:")); 
    display.println(F(" Joy Y: Change Ltr")); 
    display.println(F(" Joy X: Move Cursor")); 
    display.println();
    
    display.setCursor(4, 40); display.setTextSize(2);
    for(int i=0; i<10; i++) {
      if(i == textCursor) display.setTextColor(SSD1306_BLACK, SSD1306_WHITE); 
      else display.setTextColor(SSD1306_WHITE, SSD1306_BLACK); 
      
      if(textBuffer[i] == ' ' && i != textCursor) display.print('_'); 
      else display.print(textBuffer[i]);
    }
    
    display.setTextColor(SSD1306_WHITE, SSD1306_BLACK); 
    display.setTextSize(1); display.setCursor(0, 56); 
    display.print(F(" P")); display.print(buttonPins[BTN_IDX_OK]); display.print(F(":SAVE  P")); 
    display.print(buttonPins[BTN_IDX_BACK]); display.print(F(":CANCEL"));
    display.display(); 
    return;
  }

  if(currentCat == CAT_MAIN) display.println(F("--- MAIN MENU ---")); 
  else if(currentCat == CAT_GP_MENU) display.println(F("- GAMEPAD CONFIG -"));
  else if(currentCat == CAT_MK_MENU) display.println(F("- M+K CONFIG -"));
  else if(currentCat == CAT_PROFILES) display.println(F("--- PROFILES ---"));
  else if(currentCat == CAT_PROF_SAVE_OPT) display.println(F("- SAVE PROFILE -")); 
  else if(currentCat == CAT_LIST_LOAD) display.println(F("- LOAD PROFILE -"));
  else if(currentCat == CAT_LIST_OVERWRITE) display.println(F("- SAVE TO SLOT -")); 
  else if(currentCat == CAT_LIST_RENAME) display.println(F("- RENAME SLOT -"));
  else if(currentCat == CAT_LIST_DELETE) display.println(F("- DELETE SLOT -")); 
  else if(currentCat == CAT_GP_MAP) display.println(F("- GAMEPAD MAP -"));
  else if(currentCat == CAT_KB_MAP) display.println(F("- KEYBOARD MAP -")); 
  else if(currentCat == CAT_GP_J1 || currentCat == CAT_MK_J1) display.println(F("- JOYSTICK 1 -"));
  else if(currentCat == CAT_GP_J2 || currentCat == CAT_MK_J2) display.println(F("- JOYSTICK 2 -")); 
  else if(currentCat == CAT_MOUSE_CFG) display.println(F("- MOUSE CONFIG -"));
  else if(currentCat == CAT_SYS_CFG) display.println(F("- SYSTEM CONFIG -"));

  int maxItems = 0;
  if(currentCat==CAT_MAIN) maxItems=9; 
  else if(currentCat==CAT_GP_MENU) maxItems=3;
  else if(currentCat==CAT_MK_MENU) maxItems=4;
  else if(currentCat==CAT_PROFILES) maxItems=5; 
  else if(currentCat==CAT_PROF_SAVE_OPT) maxItems=2;
  else if(currentCat==CAT_LIST_LOAD||currentCat==CAT_LIST_OVERWRITE||currentCat==CAT_LIST_RENAME||currentCat==CAT_LIST_DELETE) maxItems=10;
  else if(currentCat==CAT_GP_MAP||currentCat==CAT_KB_MAP) maxItems=13; 
  else if(currentCat==CAT_GP_J1||currentCat==CAT_GP_J2||currentCat==CAT_MK_J2) maxItems=4; 
  else if(currentCat==CAT_MK_J1||currentCat==CAT_MOUSE_CFG) maxItems=3;
  else if(currentCat==CAT_SYS_CFG) maxItems=5; 

  int startIdx = max(0, min(scrollIndex - 2, maxItems - 5));

  for (int i = 0; i < 5 && (startIdx + i) < maxItems; i++) {
    int idx = startIdx + i;
    
    if (currentCat == CAT_MAIN) {
      if(idx==scrollIndex) display.print(F(" > ")); else display.print(F("   "));
      if(idx==0) display.println(F("Start Gamepad")); 
      else if(idx==1) display.println(F("Start Mouse+Keys")); 
      else if(idx==2) display.println(F("Auto-Calibrate")); 
      else if(idx==3) { display.print(F("Conn: ")); display.println(conf_use_ble ? F("BLUETOOTH") : F("USB OTG")); }
      else if(idx==4) display.println(F("Profiles")); 
      else if(idx==5) display.println(F("Gamepad Config")); 
      else if(idx==6) display.println(F("M+K Config"));
      else if(idx==7) display.println(F("System Config")); 
      else if(idx==8) display.println(F("Hardware Tester")); 
    }
    else if (currentCat == CAT_GP_MENU) {
      if(idx==scrollIndex) display.print(F(" > ")); else display.print(F("   "));
      if(idx==0) display.println(F("Button Mapping")); else if(idx==1) display.println(F("Joy 1 Settings")); else if(idx==2) display.println(F("Joy 2 Settings"));
    }
    else if (currentCat == CAT_MK_MENU) {
      if(idx==scrollIndex) display.print(F(" > ")); else display.print(F("   "));
      if(idx==0) display.println(F("Key Mapping")); else if(idx==1) display.println(F("Joy 1 Settings")); 
      else if(idx==2) display.println(F("Joy 2 Settings")); else if(idx==3) display.println(F("Mouse Settings"));
    }
    else if (currentCat == CAT_PROFILES) {
      if(idx==scrollIndex) display.print(F(" > ")); else display.print(F("   "));
      if(idx==0) display.println(F("Load Profile")); else if(idx==1) display.println(F("New Profile"));
      else if(idx==2) display.println(F("Save Current Prof")); else if(idx==3) display.println(F("Rename Profile")); else if(idx==4) display.println(F("Delete Profile"));
    }
    else if (currentCat == CAT_PROF_SAVE_OPT) {
      if(idx==scrollIndex) display.print(F(" > ")); else display.print(F("   "));
      if(idx==0) display.println(F("Overwrite Existing")); else if(idx==1) display.println(F("Save as New"));
    }
    else if (currentCat == CAT_LIST_LOAD || currentCat == CAT_LIST_OVERWRITE || currentCat == CAT_LIST_RENAME || currentCat == CAT_LIST_DELETE) {
      if(idx==scrollIndex) display.print(F(" > ")); else display.print(F("   "));
      display.print(idx + 1); display.print(F(". "));
      if (profNames[idx] == "") display.println(F("[Empty]")); else display.println(profNames[idx]);
    }
    else if (currentCat == CAT_GP_MAP || currentCat == CAT_KB_MAP) {
      display.print(idx == scrollIndex ? (isEditing ? F(">[") : F(" > ")) : F("  "));
      display.print(F("Pin ")); display.print(buttonPins[idx]); display.print(F(": "));
      if (isEditing && idx == scrollIndex) { display.print(currentCat == CAT_GP_MAP ? gpNames[editValue] : kbNames[editValue]); display.println(F("]")); } 
      else display.println(currentCat == CAT_GP_MAP ? gpNames[gp_map_idx[idx]] : kbNames[kb_map_idx[idx]]);
    }
    else if (currentCat == CAT_GP_J1 || currentCat == CAT_MK_J1) {
      bool swp = (currentCat==CAT_GP_J1) ? gp_j1_swap : mk_j1_swap;
      bool ix = (currentCat==CAT_GP_J1) ? gp_j1_invX : mk_j1_invX;
      bool iy = (currentCat==CAT_GP_J1) ? gp_j1_invY : mk_j1_invY;
      if(idx==0) printMenuRow(idx, "Swap XY: ", swp?"TRUE":"FALSE", true);
      if(idx==1) printMenuRow(idx, "Invert X: ", ix?"TRUE":"FALSE", true);
      if(idx==2) printMenuRow(idx, "Invert Y: ", iy?"TRUE":"FALSE", true);
      if(idx==3 && currentCat == CAT_GP_J1) {
        const char* modes[] = {"L-STICK", "R-STICK", "D-PAD"};
        display.print(idx == scrollIndex ? (isEditing ? F(">[Mode: ") : F(" >Mode: ")) : F("  Mode: "));
        display.print(isEditing && idx == scrollIndex ? modes[editValue] : modes[gp_j1_mode]);
        if(isEditing && idx == scrollIndex) display.println(F("]")); else display.println();
      }
    }
    else if (currentCat == CAT_GP_J2 || currentCat == CAT_MK_J2) {
      bool swp = (currentCat==CAT_GP_J2) ? gp_j2_swap : mk_j2_swap;
      bool ix = (currentCat==CAT_GP_J2) ? gp_j2_invX : mk_j2_invX;
      bool iy = (currentCat==CAT_GP_J2) ? gp_j2_invY : mk_j2_invY;
      if(idx==0) printMenuRow(idx, "Swap XY: ", swp?"TRUE":"FALSE", true);
      if(idx==1) printMenuRow(idx, "Invert X: ", ix?"TRUE":"FALSE", true);
      if(idx==2) printMenuRow(idx, "Invert Y: ", iy?"TRUE":"FALSE", true);
      if(idx==3) {
        if (currentCat == CAT_GP_J2) {
          const char* modes[] = {"L-STICK", "R-STICK", "D-PAD"};
          display.print(idx == scrollIndex ? (isEditing ? F(">[Mode: ") : F(" >Mode: ")) : F("  Mode: "));
          display.print(isEditing && idx == scrollIndex ? modes[editValue] : modes[gp_j2_mode]);
          if(isEditing && idx == scrollIndex) display.println(F("]")); else display.println();
        } else {
          const char* modes[] = {"NONE", "ARROWS", "WASD"};
          display.print(idx == scrollIndex ? (isEditing ? F(">[Mode: ") : F(" >Mode: ")) : F("  Mode: "));
          display.print(isEditing && idx == scrollIndex ? modes[editValue] : modes[mk_j2_mode]);
          if(isEditing && idx == scrollIndex) display.println(F("]")); else display.println();
        }
      }
    }
    else if (currentCat == CAT_MOUSE_CFG) {
      if(idx==0) { display.print(idx == scrollIndex ? (isEditing ? F(">[Sens: ") : F(" >Sens: ")) : F("  Sens: ")); display.print(isEditing && idx == scrollIndex ? editValue : conf_mouse_sens); if(isEditing && idx == scrollIndex) display.println(F("]")); else display.println(); }
      if(idx==1) { display.print(idx == scrollIndex ? (isEditing ? F(">[Accel: ") : F(" >Accel: ")) : F("  Accel: ")); display.print(isEditing && idx == scrollIndex ? (float)editValue/10.0 : conf_mouse_accel, 1); if(isEditing && idx == scrollIndex) display.println(F("]")); else display.println(); }
      if(idx==2) { display.print(idx == scrollIndex ? (isEditing ? F(">[DZone: ") : F(" >DZone: ")) : F("  DZone: ")); display.print(isEditing && idx == scrollIndex ? editValue : conf_deadzone); if(isEditing && idx == scrollIndex) display.println(F("]")); else display.println(); }
    }
    else if (currentCat == CAT_SYS_CFG) {
      if(idx==0) {
        const char* opts[] = {"GEMINI", "MISSILIS", "MARCEL", "SHORES", "ZZZ", "TEXT", "AUTO"};
        display.print(idx == scrollIndex ? (isEditing ? F(">[Boot: ") : F(" >Boot: ")) : F("  Boot: "));
        display.print(isEditing && idx == scrollIndex ? opts[editValue] : opts[conf_boot_logo]);
        if(isEditing && idx == scrollIndex) display.println(F("]")); else display.println();
      }
      if(idx==1) printMenuRow(idx, "Invert: ", conf_boot_invert?"TRUE":"FALSE", true);
      if(idx==2) {
        display.print(idx == scrollIndex ? (isEditing ? F(">[OK Btn: P") : F(" >OK Btn: P")) : F("  OK Btn: P"));
        display.print(buttonPins[isEditing && idx == scrollIndex ? editValue : BTN_IDX_OK]);
        if(isEditing && idx == scrollIndex) display.println(F("]")); else display.println();
      }
      if(idx==3) {
        display.print(idx == scrollIndex ? (isEditing ? F(">[BackBtn: P") : F(" >BackBtn: P")) : F("  BackBtn: P"));
        display.print(buttonPins[isEditing && idx == scrollIndex ? editValue : BTN_IDX_BACK]);
        if(isEditing && idx == scrollIndex) display.println(F("]")); else display.println();
      }
      if(idx==4) printMenuRow(idx, "Factory Reset", "", true);
    }
  }
  display.display();
}

// ==========================================
// TESTER, GAMEPAD, AND MOUSE LOGIC 
// ==========================================

void handleTester() {
  int j1x = analogRead(JOY1_X); int j1y = analogRead(JOY1_Y);
  int j2x = analogRead(JOY2_X); int j2y = analogRead(JOY2_Y);
  
  static unsigned long lastOledUpdate = 0;
  if (millis() - lastOledUpdate > 100) {
    display.clearDisplay(); display.setTextColor(SSD1306_WHITE); display.setTextSize(1); display.setCursor(0, 0);
    display.print(F("J1 X:")); display.print(j1x); display.print(F(" Y:")); display.println(j1y);
    display.print(F("J2 X:")); display.print(j2x); display.print(F(" Y:")); display.println(j2y);
    display.println(); display.println(F("Buttons Pressed:"));
    
    bool anyBtn = false;
    for (int i = 0; i < 13; i++) {
      if (buttonStates[i]) {
        display.print(F("[")); display.print(buttonPins[i]); display.print(F("]"));
        anyBtn = true;
      }
    }
    if (!anyBtn) display.print(F("NONE"));
    
    display.setCursor(0, 56); 
    display.print(F("Hold P")); display.print(buttonPins[BTN_IDX_MENU_1]); 
    display.print(F("+P")); display.print(buttonPins[BTN_IDX_MENU_2]); display.print(F("->EXIT")); 
    display.display();
    lastOledUpdate = millis();
  }
}

void handleGamepad() {
  int8_t j1x, j1y, j2x, j2y; 
  getJoystickStates(j1x, j1y, j2x, j2y, true);
  
  uint32_t buttons = 0; bool dUp=false, dDown=false, dLeft=false, dRight=false;
  int8_t triggerL = 0; int8_t triggerR = 0; 
  int8_t leftX = 0, leftY = 0, rightX = 0, rightY = 0;

  for (int i = 0; i < 13; i++) {
    if (buttonStates[i]) {
      uint32_t mapping = gpValues[gp_map_idx[i]];
      if (mapping == DPAD_UP) dUp = true; 
      else if (mapping == DPAD_DOWN) dDown = true; 
      else if (mapping == DPAD_LEFT) dLeft = true; 
      else if (mapping == DPAD_RIGHT) dRight = true;
      else {
        buttons |= mapping;
        if (mapping == BTN_L2) triggerL = 127; 
        if (mapping == BTN_R2) triggerR = 127;
      }
    }
  }
  
  if (gp_j1_mode == 0) { leftX = j1x; leftY = j1y; } 
  else if (gp_j1_mode == 1) { rightX = j1x; rightY = j1y; } 
  else if (gp_j1_mode == 2) { 
    if (j1y < -64) dUp = true; else if (j1y > 64) dDown = true;
    if (j1x < -64) dLeft = true; else if (j1x > 64) dRight = true;
  }

  if (gp_j2_mode == 0) { leftX = j2x; leftY = j2y; } 
  else if (gp_j2_mode == 1) { rightX = j2x; rightY = j2y; } 
  else if (gp_j2_mode == 2) { 
    if (j2y < -64) dUp = true; else if (j2y > 64) dDown = true;
    if (j2x < -64) dLeft = true; else if (j2x > 64) dRight = true;
  }
  
  uint8_t hat = 0; 
  if (dUp && dRight) hat = 2; else if (dDown && dRight) hat = 4; else if (dDown && dLeft) hat = 6; else if (dUp && dLeft) hat = 8;
  else if (dUp) hat = 1; else if (dRight) hat = 3; else if (dDown) hat = 5; else if (dLeft) hat = 7;
  
  // ANTI-SPAM LOGIC
  bool stateChanged = false;
  if (leftX != last_gp_j1x || leftY != last_gp_j1y || rightX != last_gp_j2x || rightY != last_gp_j2y ||
      triggerL != last_gp_trigL || triggerR != last_gp_trigR || hat != last_gp_hat || buttons != last_gp_btn) {
    stateChanged = true;
  }

  if (stateChanged) {
    if (conf_use_ble) {
      if (bleGamepad.isConnected()) {
        bleGamepad.setLeftThumb(map(leftX, -127, 127, -32767, 32767), map(leftY, -127, 127, -32767, 32767));
        bleGamepad.setRightThumb(map(rightX, -127, 127, -32767, 32767), map(rightY, -127, 127, -32767, 32767));
        bleGamepad.setLeftTrigger(triggerL > 0 ? 32767 : 0);
        bleGamepad.setRightTrigger(triggerR > 0 ? 32767 : 0);
        bleGamepad.setHat1(hat);
        for (int i=0; i<16; i++) {
          if (buttons & (1<<i)) bleGamepad.press(i+1);
          else bleGamepad.release(i+1);
        }
      }
    } else {
      Gamepad.send(leftX, leftY, rightX, rightY, triggerL, triggerR, hat, buttons);
    }
    last_gp_j1x = leftX; last_gp_j1y = leftY; last_gp_j2x = rightX; last_gp_j2y = rightY;
    last_gp_trigL = triggerL; last_gp_trigR = triggerR; last_gp_hat = hat; last_gp_btn = buttons;
  }
  
  // Update screen at a slower 2Hz to prevent display lag while gaming!
  if (millis() - lastOledUpdate > 500) {
    display.clearDisplay(); display.setTextColor(SSD1306_WHITE); 
    display.setTextSize(2); display.setCursor(0, 10); display.println(conf_use_ble ? F("BLEGAMEPAD") : F("USBGAMEPAD"));
    display.setTextSize(1); display.setCursor(0, 30); 
    if (conf_use_ble) display.println(bleGamepad.isConnected() ? F("Status: CONNECTED") : F("Status: PAIRING..."));
    display.setCursor(0, 48); 
    display.print(F("Hold P")); display.print(buttonPins[BTN_IDX_MENU_1]); 
    display.print(F(" & P")); display.println(buttonPins[BTN_IDX_MENU_2]); 
    display.println(F("to open OS Menu")); 
    display.display();
    lastOledUpdate = millis();
  }
}

void handleMouse() {
  if (conf_use_ble) {
    if (millis() - lastOledUpdate > 500) {
      display.clearDisplay(); display.setTextColor(SSD1306_WHITE); display.setTextSize(2);
      display.setCursor(0, 10); display.println(F("ERROR:"));
      display.setTextSize(1); display.setCursor(0, 30);
      display.println(F("M+K requires USB!")); display.println(F("Change connection")); display.println(F("in Main Menu.")); display.display();
      lastOledUpdate = millis();
    }
    return;
  }

   // THE FIX: Continuously send a neutral Gamepad heartbeat in the background
  // This tricks ZZZ into recognizing the controller while you navigate with the mouse!
  Gamepad.send(0, 0, 0, 0, 0, 0, 0, 0); 

  int8_t j1x, j1y, j2x, j2y; getJoystickStates(j1x, j1y, j2x, j2y, false); 
  float mouseMoveX = 0, mouseMoveY = 0;
  if (j1x != 0) { mouseMoveX = conf_mouse_sens * pow(abs((float)j1x) / 127.0, conf_mouse_accel); if (j1x < 0) mouseMoveX = -mouseMoveX; }
  if (j1y != 0) { mouseMoveY = conf_mouse_sens * pow(abs((float)j1y) / 127.0, conf_mouse_accel); if (j1y < 0) mouseMoveY = -mouseMoveY; }
  
  if (mouseMoveX != 0 || mouseMoveY != 0) {
    Mouse.move((int)mouseMoveX, (int)mouseMoveY, 0);
  }

  for (int i = 0; i < 13; i++) {
    uint8_t keyChar = kbValues[kb_map_idx[i]];
    if (keyChar != 0) {
      if (buttonStates[i] && !lastButtonStates[i]) {
        if (keyChar == CMD_M_LEFT) Mouse.press(MOUSE_LEFT);
        else if (keyChar == CMD_M_RIGHT) Mouse.press(MOUSE_RIGHT);
        else if (keyChar == CMD_M_MID) Mouse.press(MOUSE_MIDDLE);
        else Keyboard.press(keyChar);
      }
      if (!buttonStates[i] && lastButtonStates[i]) {
        if (keyChar == CMD_M_LEFT) Mouse.release(MOUSE_LEFT);
        else if (keyChar == CMD_M_RIGHT) Mouse.release(MOUSE_RIGHT);
        else if (keyChar == CMD_M_MID) Mouse.release(MOUSE_MIDDLE);
        else Keyboard.release(keyChar);
      }
    }
  }

  if (mk_j2_mode > 0) {
    uint8_t upKey = 0, downKey = 0, leftKey = 0, rightKey = 0;
    if (mk_j2_mode == 1) { upKey=KEY_UP_ARROW; downKey=KEY_DOWN_ARROW; leftKey=KEY_LEFT_ARROW; rightKey=KEY_RIGHT_ARROW; }
    else if (mk_j2_mode == 2) { upKey='w'; downKey='s'; leftKey='a'; rightKey='d'; }
    bool jUp = (j2y < -64); bool jDown = (j2y > 64); bool jLeft = (j2x < -64); bool jRight = (j2x > 64);
    static bool ljUp=false, ljDown=false, ljLeft=false, ljRight=false;
    if(jUp && !ljUp) Keyboard.press(upKey); if(!jUp && ljUp) Keyboard.release(upKey);
    if(jDown && !ljDown) Keyboard.press(downKey); if(!jDown && ljDown) Keyboard.release(downKey);
    if(jLeft && !ljLeft) Keyboard.press(leftKey); if(!jLeft && ljLeft) Keyboard.release(leftKey);
    if(jRight && !ljRight) Keyboard.press(rightKey); if(!jRight && ljRight) Keyboard.release(rightKey);
    ljUp = jUp; ljDown = jDown; ljLeft = jLeft; ljRight = jRight;
  }

  if (millis() - lastOledUpdate > 500) {
    display.clearDisplay(); display.setTextColor(SSD1306_WHITE); display.setTextSize(2); display.setCursor(0, 10); display.println(F("MOUSE+KEYS"));
    display.setTextSize(1); display.setCursor(0, 40); 
    display.print(F("Hold P")); display.print(buttonPins[BTN_IDX_MENU_1]); 
    display.print(F(" & P")); display.println(buttonPins[BTN_IDX_MENU_2]); 
    display.println(F("to open OS Menu")); 
    display.display();
    lastOledUpdate = millis();
  }
}